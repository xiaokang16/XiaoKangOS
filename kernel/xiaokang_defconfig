## kernel/xiaokang_defconfig
```kconfig
#
# XiaoKangOS Custom Kernel Configuration
# Based on Linux 6.6
# Optimized for minimal size and fast boot
#

CONFIG_LOCALVERSION="-xiaokang"
CONFIG_LOCALVERSION_AUTO=y
CONFIG_DEFAULT_HOSTNAME="xiaokang"
CONFIG_SYSVIPC=y
CONFIG_POSIX_TIMERS=y
CONFIG_AUDIT=y
CONFIG_HARDEN_EL2_VECTORS=y
CONFIG_RANDOMIZE_BASE=y
CONFIG_LEGACY_VSYSCALL_NONE=y

# Processor type and features
CONFIG_X86_64=y
CONFIG_X86=y
CONFIG_MICROCODE=y
CONFIG_MICROCODE_INTEL=y
CONFIG_MICROCODE_AMD=y
CONFIG_X86_MPPARSE=y
CONFIG_X86_INTEL_TSX_MODE_AUTO=y
CONFIG_X86_FRED=y
CONFIG_CPUIDLE_GOV_TEO=y
CONFIG_CPU_IDLE_GOV_TEO=y

# Memory management
CONFIG_ZSWAP=y
CONFIG_ZSMALLOC=y
CONFIG_PGTABLE_3=y
CONFIG_HUGETLB_PAGE=y
CONFIG_MEMORY_BALLOON=y
CONFIG_BALLOON_COMPACTION=y
CONFIG_COMPACTION=y
CONFIG_PAGE_REPORTING=y

# Networking
CONFIG_NET=y
CONFIG_PACKET=y
CONFIG_UNIX=y
CONFIG_INET=y
CONFIG_IP_PNP=y
CONFIG_IP_PNP_DHCP=y
CONFIG_IP_PNP_BOOTP=y
CONFIG_IP_PNP_RARP=y
CONFIG_NET_IPVTI=y
CONFIG_NET_UDP_TUNNEL=y
CONFIG_NET_FOU=y
CONFIG_NET_FOU_IP_TUNNELS=y
CONFIG_INET_AH=y
CONFIG_INET_ESP=y
CONFIG_INET_ESP_OFFLOAD=y
CONFIG_INET_IPCOMP=y
CONFIG_INET_DIAG=y
CONFIG_TCP_CONG_ADVANCED=y
CONFIG_TCP_CONG_BBR=y
CONFIG_DEFAULT_BBR=y
CONFIG_NETFILTER=y
CONFIG_NF_CONNTRACK=y
CONFIG_NF_LOG_IPV4=y
CONFIG_IP_NF_IPTABLES=y
CONFIG_IP_NF_FILTER=y

# Device Drivers
CONFIG_STMMAC_ETH=y
CONFIG_MDIO=y
CONFIG_E1000=y
CONFIG_E1000E=y
CONFIG_IGB=y
CONFIG_IXGBE=y
CONFIG_VIRTIO=y
CONFIG_VIRTIO_PCI=y
CONFIG_VIRTIO_BALLOON=y
CONFIG_VIRTIO_BLK=y
CONFIG_VIRTIO_CONSOLE=y

# Graphics support
CONFIG_DRM=y
CONFIG_DRM_FBDEV_EMULATION=y
CONFIG_DRM_FBDEV_OVERALLOC=100
CONFIG_FRAMEBUFFER_CONSOLE=y
CONFIG_FRAMEBUFFER_CONSOLE_DETECT_PRIMARY=y
CONFIG_LOGO=y
CONFIG_LOGO_LINUX_MONO=y
CONFIG_LOGO_LINUX_VGA16=y
CONFIG_LOGO_LINUX_CLUT224=y
CONFIG_SOUND=y
CONFIG_SND=y
CONFIG_SND_HDA_INTEL=y
CONFIG_SND_HDA_CODEC_HDMI=y

# NVIDIA Support (optional)
CONFIG_NVIDIA=m
CONFIG_NVIDIA_UVM=m
CONFIG_NVIDIA_DRM=m

# Virtualization
CONFIG_VIRT_DRIVERS=y
CONFIG_KVM_GUEST=y
CONFIG_HYPERV=y
CONFIG_HYPERV_UTILS=y
CONFIG_PARAVIRT=y
CONFIG_KVM_X86=y

# File systems
CONFIG_EXT4_FS=y
CONFIG_EXT4_FS_POSIX_ACL=y
CONFIG_EXT4_FS_SECURITY=y
CONFIG_BTRFS_FS=y
CONFIG_XFS_FS=y
CONFIG_F2FS_FS=y
CONFIG_ISO9660_FS=y
CONFIG_JOLIET=y
CONFIG_ZISOFS=y
CONFIG_UDF_FS=y
CONFIG_SQUASHFS=y
CONFIG_SQUASHFS_FILE_CACHE=y
CONFIG_SQUASHFS_DECOMP_SINGLE=y
CONFIG_OVERLAY_FS=y

# Kernel compression
CONFIG_KERNEL_LZ4=y
CONFIG_KERNEL_LZMA=y
CONFIG_KERNEL_XZ=y
CONFIG_KERNEL_ZSTD=y
CONFIG_INITRAMFS_COMPRESSION_LZ4=y
CONFIG_INITRAMFS_COMPRESSION=".lz4"

# Boot options
CONFIG_CMDLINE_BOOL=y
CONFIG_CMDLINE="quiet splash loglevel=0 console=tty1"
CONFIG_EFI=y
CONFIG_EFI_STUB=y
CONFIG_EFI_FAKE_MEMMAP=y
CONFIG_FB_EFI=y
CONFIG_FRAMEBUFFER_CONSOLE=y

# TTY settings
CONFIG_VT=y
CONFIG_CONSOLE_TRANSLATIONS=y
CONFIG_VT_CONSOLE=y
CONFIG_HW_CONSOLE=y
CONFIG_SERIAL_8250=y
CONFIG_SERIAL_8250_CONSOLE=y
CONFIG_SERIAL_CORE=y
CONFIG_SERIAL_CORE_CONSOLE=y

# Security
CONFIG_SECURITY=y
CONFIG_SECURITY_NETWORK=y
CONFIG_SECURITY_PATH=y
CONFIG_LSM="lockdown,yama,loadpin,safesetid,integrity"
CONFIG_HARDENED_USERCOPY=y
CONFIG_FORTIFY_SOURCE=y
CONFIG_RANDOMIZE_MEMORY=y
CONFIG_STACKPROTECTOR=y

# Debugging (disabled for production)
# CONFIG_DEBUG_KERNEL is not set
# CONFIG_DEBUG_INFO is not set

# CPU Frequency scaling
CONFIG_CPU_FREQ=y
CONFIG_CPU_FREQ_GOV_POWERSAVE=y
CONFIG_CPU_FREQ_GOV_PERFORMANCE=y
CONFIG_CPU_FREQ_GOV_ONDEMAND=y
CONFIG_CPU_FREQ_GOV_CONSERVATIVE=y

# Thermal management
CONFIG_THERMAL=y
CONFIG_THERMAL_HWMON=y

# ACPI
CONFIG_ACPI=y
CONFIG_ACPI_BUTTON=y
CONFIG_ACPI_FAN=y
CONFIG_ACPI_THERMAL=y

# USB
CONFIG_USB=y
CONFIG_USB_XHCI_HCD=y
CONFIG_USB_EHCI_HCD=y
CONFIG_USB_OHCI_HCD=y
CONFIG_USB_STORAGE=y
CONFIG_USB_PRINTER=y
CONFIG_USB_SERIAL=y
CONFIG_USB_MASS_STORAGE=y

# MMC/SD
CONFIG_MMC=y
CONFIG_MMC_BLOCK=y
CONFIG_SDIO_UART=y

# Embedded options
CONFIG_EMBEDDED=y
CONFIG_EXPERT=y
CONFIG_SLOB=y
```
